#include <Arduboy2.h>
#include "Particule.h" 
#include "GameOver.h"
Arduboy2 arduboy; //Creation of the object arduboy
//Definition of minus, plus and bande sprites (setting)
const unsigned char minus[] PROGMEM=
{
  32, 32,
  0x00, 0x00, 0x00, 0x00, 0x00, 0x00, 0x00, 0x00, 0x00, 0x00, 0x00,
  0x00, 0x00, 0x00, 0x00, 0x00, 0x00, 0x00, 0x00, 0x00, 0x00, 0x00,
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  0x00, 0x00, 0x00, 0x00, 0x00, 0x00, 0x00, 0x00, 0x00, 
  };
  
const unsigned char plus[] PROGMEM=
{
  32,32,
  0x00, 0x00, 0x00, 0x00, 0x00, 0x00, 0x00, 0x00, 0x00, 0x00, 0x00,
  0x00, 0x00, 0x00, 0xff, 0xff, 0xff, 0xff, 0x00, 0x00, 0x00, 0x00,
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  0x00, 0x00, 0x00, 0x00, 0x00, 0x00, 0x00, 0x00, 0x00, 0x00, 0x00, 
};

const unsigned char bande[] PROGMEM=
{
 30,63,
 0xff, 0xff, 0x00, 0x00, 0x00, 0x00, 0x00, 0x00, 0x00, 0x00, 0x00, 0x00,
 0x00, 0x00, 0x00, 0x00, 0x00, 0x00, 0x00, 0x00, 0x00, 0x00, 0x00, 0x00,
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 0x00, 0x00, 0x00, 0x00, 0x00, 0x00, 0x7f, 0x7f,  
};

//Definition of the Title Screen
const unsigned char TitleScreen[] PROGMEM=
{
  127,63,
  0x00, 0x00, 0x00, 0x00, 0x00, 0xfc, 0xfc, 0x8c, 0x8c, 0x8c, 0x8c, 0x8c,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 0x00
  , 0x00, 0x3e, 0xa, 0x1a, 0x2e, 0x00, 0x00, 0x1c, 0x22, 0x22, 0x1c, 0x00,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 0x00, 
};
//Definition of the cute drawing
const unsigned char GameOverdecor[] PROGMEM=
{
  20,20,
  0x00, 0x00, 0x00, 0x00, 0x00, 0x78, 0x84, 0x4, 0x4, 0x8, 0x8, 0x4, 0x4,
  0x84, 0x78, 0x00, 0x00, 0x00, 0x00, 0x00, 0xe0, 0x10, 0xc8, 0xe8, 0xe8,
  0xc8, 0x10, 0xe1, 0x2, 0x4, 0x4, 0x2, 0xe1, 0x10, 0xc8, 0xc8, 0xc8, 0xc8,
  0x10, 0xe0, 0x1, 0x2, 0x4, 0x5, 0x5, 0x4, 0x2, 0x1, 0x00, 0x00, 0x00,
  0x00,0x1, 0x2, 0x4, 0x4, 0x4, 0x4, 0x2, 0x1, 
};


//Particulesprite's definition
const unsigned char particulesprite[] PROGMEM=
{
  8,8,
  0x3c, 0x42, 0x99, 0x99, 0x99, 0x99, 0x42, 0x3c, 0x3c, 0x42, 0x99, 0xbd,
  0xbd, 0x99, 0x42, 0x3c, 
};

int justpressed=0;
int gamestatus=0;
int score=0;
int count; //tells how many frames appeared
GameOver gameover; //Creating gameover
Particule particule1; //Creation of 5 particules
Particule particule2;
Particule particule3;
Particule particule4;
Particule particule5;


void setup() {
  arduboy.begin();
  arduboy.setFrameRate(15); //15 frames per second
  }

void loop() {
  if (!(arduboy.nextFrame()))
    return;
  arduboy.clear();
  

  switch(gamestatus){
    case 0: //Take care of the title screen
      Sprites::drawSelfMasked(0,0,TitleScreen,0);
      if(arduboy.pressed(A_BUTTON) and justpressed == 0){
        justpressed=1;
        gamestatus=1;}
      break;
    case 1://Take care of the core gameplay
      arduboy.clear();
      
      //Adds 1 to counter and print the number on screen and print score
      count++;
      arduboy.setCursor(0,0);
      arduboy.print(count);
      arduboy.setCursor(80,0);
      arduboy.print(score);
     
      
      //Bande, minus, plus are displayed
      Sprites::drawSelfMasked(49,0,bande,0);
      Sprites::drawSelfMasked(8,16,minus,0);
      Sprites::drawSelfMasked(127-32-7,16,plus,0);
      //Definition of particule2.y etc
      particule2.y=-35;
      particule3.y=-55;
      particule4.y=-75;
      particule5.y=-100;
      //Displaying particule1,2,3,4 and 5 !
      particule1.Draw(particulesprite);
      particule2.Draw(particulesprite);
      particule3.Draw(particulesprite);
      particule4.Draw(particulesprite);
      particule5.Draw(particulesprite);
      
      //These lines block the particles in the circle
      particule1.coordonnee();
      particule2.coordonnee();
      particule3.coordonnee();
      particule4.coordonnee();
      particule5.coordonnee();
      
      //Verif of particule1
      if (particule1.Verif()==-1){
        gamestatus=2;
        break;
      }
      if (particule1.Verif()==2){
        score++;
      }
      //Verif of particule2
      if (particule2.Verif()==-1){
        gamestatus=2;
        break;
      }
      if (particule2.Verif()==2){
        score++;
      }
      //Verif of particule3
      if (particule3.Verif()==-1){
        gamestatus=2;
        break;
      }
      if (particule3.Verif()==2){
        score++;
      }
      //Verif of particule4
      if (particule4.Verif()==-1){
        gamestatus=2;
        break;
      }
      if (particule4.Verif()==2){
        score++;
      }
      //Verif of particule5
      if (particule5.Verif()==-1){
        gamestatus=2;
        break;
      }
      if (particule5.Verif()==2){
        score++;
      }
      
      arduboy.display();
      break;    
    
///////////////////////////////////////////////////////////////////////////////////    
    
    case 2: //Take care of the Game Over Screen
      arduboy.clear();
      arduboy.setCursor(0,0);
      arduboy.print("Game over !");
      gameover.Draw(GameOverdecor);
      arduboy.setCursor(0,50);
      arduboy.print(score);
      arduboy.setCursor(0,30);
      arduboy.print("Press A button !");
      arduboy.display();
      if(arduboy.pressed(A_BUTTON) and justpressed == 0){
        justpressed=1;
        gamestatus=0;
      }
      break;
    }
  
  if(arduboy.notPressed(A_BUTTON)) {
    justpressed = 0;
  }
  arduboy.display();
}
